## components/esp_rt_diagnostics/Kconfig
```kconfig
menu "ESP Real-Time Diagnostics"

    config ESP_RT_DIAGNOSTICS_ENABLE
        bool "Enable real-time diagnostic snapshots"
        default y
        help
            Collect bounded timing statistics and event counters inside
            deterministic tasks. This enables cycle, ISR-to-task wake,
            deadline, missed-event, and application-event accounting.

            Disable this option after development to compile the inline
            instrumentation into no-ops in the critical path. The out-of-line
            snapshot and derived-value symbols remain linkable, but an
            application normally compile-gates its accumulator and reporter.

    config ESP_RT_DIAGNOSTICS_DETAILED_TIMING
        bool "Measure named stages and periodic intervals"
        depends on ESP_RT_DIAGNOSTICS_ENABLE
        default y
        help
            Collect per-stage average/maximum execution times, configured
            budget violations, and min/max intervals. Core cycle,
            missed-event, error, and deadline counters remain part of the base
            diagnostics when this option is disabled.

            Each stage_begin/stage_end pair reads esp_timer, so leave this off
            when only aggregate deadline evidence is required or when
            characterizing the instrumentation's own cost.

    config ESP_RT_DIAGNOSTICS_WINDOW_MS
        int "Diagnostic snapshot window (ms)"
        depends on ESP_RT_DIAGNOSTICS_ENABLE
        range 100 3600000
        default 5000
        help
            Default duration accumulated before a diagnostic snapshot becomes
            due. Each esp_rt_diag_config_t may override it with its own
            window_duration_us, allowing independent monitoring windows for
            tasks with different periods.

endmenu
```

## components/esp_timeseries_usb_transport/Kconfig
```kconfig
menu "ESP Time-Series USB Transport"

    config ESP_TIMESERIES_USB_TRANSPORT_ENABLE
        bool "Enable USB Serial/JTAG recorder transport"
        depends on SOC_USB_SERIAL_JTAG_SUPPORTED
        default y
        help
            Reserve the ESP32-S3 native USB Serial/JTAG CDC port for recorder
            commands and binary dumps. The component creates a Core 0 command
            task and owns the native USB Serial/JTAG driver. Console output must
            use UART only so logs cannot corrupt a binary payload.

    config ESP_TIMESERIES_USB_RX_BUFFER_BYTES
        int "USB command receive buffer (bytes)"
        depends on ESP_TIMESERIES_USB_TRANSPORT_ENABLE
        range 128 4096
        default 512
        help
            Native USB driver ring used for ASCII command input and extension
            binary payloads. This is not the maximum command length: core
            command lines are limited to 63 characters plus termination.

    config ESP_TIMESERIES_USB_TX_BUFFER_BYTES
        int "USB transmission buffer (bytes)"
        depends on ESP_TIMESERIES_USB_TRANSPORT_ENABLE
        range 1024 16384
        default 16384
        help
            Native USB driver ring used for responses and binary recorder
            dumps. A larger ring can improve throughput when the host consumes
            data promptly, at the cost of additional internal RAM. Payloads are
            submitted to the driver in smaller fixed chunks.

    config ESP_TIMESERIES_USB_WRITE_TIMEOUT_MS
        int "Per-block USB write timeout (ms)"
        depends on ESP_TIMESERIES_USB_TRANSPORT_ENABLE
        range 100 30000
        default 3000
        help
            Maximum no-progress interval for each exact read/write operation
            used by the core protocol or an extension callback. A timed-out
            dump leaves the recorder FULL, allowing DUMP to be requested again
            after reconnecting.

endmenu
```

## main/Kconfig.projbuild
```kconfig
menu "Application I2C Configurations"

    config APP_I2C_SDA_PIN
        int "GPIO number for I2C SDA"
        default 8
        help
            GPIO connected to the MT6701 SDA line. The application creates
            I2C port 0 on Core 1 and enables the ESP32 internal pull-up only
            as a fallback. At 1 MHz, use an appropriate external pull-up and
            short wiring. The pin must not be assigned to another peripheral.

    config APP_I2C_SCL_PIN
        int "GPIO number for I2C SCL"
        default 9
        help
            GPIO connected to the MT6701 SCL line. It shares I2C port 0 with
            the SDA option above and must not be assigned elsewhere. External
            pull-up and bus timing requirements are the same as for SDA.

    config APP_I2C_CLOCK_HZ
        int "MT6701 I2C clock frequency (Hz)"
        range 100000 1000000
        default 1000000
        help
            I2C clock used to read the MT6701. The sensor supports up to
            1 MHz, provided the physical bus meets its 150 ns maximum
            SDA/SCL rise and fall times. Use 400000 as a conservative fallback.

endmenu

menu "Real-Time Diagnostics Presentation"

    choice APP_RT_DIAGNOSTICS_APPLICATION_REPORT
        prompt "Application telemetry beside RT diagnostics"
        depends on ESP_RT_DIAGNOSTICS_ENABLE
        default APP_RT_DIAGNOSTICS_APPLICATION_REPORT_COMPACT
        help
            Select how much application state is printed after each generic
            RT_DIAG snapshot. This does not affect startup, error, USB
            protocol, or generic diagnostic messages.

        config APP_RT_DIAGNOSTICS_APPLICATION_REPORT_NONE
            bool "None"
            help
                Suppress application state lines. Generic RT_DIAG reports
                remain enabled and continue to show timing, missed releases,
                overruns, stages, events, and intervals. This minimizes serial
                traffic while retaining reusable timing diagnostics.

        config APP_RT_DIAGNOSTICS_APPLICATION_REPORT_COMPACT
            bool "Compact state marker"
            help
                Print one short line containing operating mode, reference,
                speed, output, and recorder state. This is recommended while
                correlating timing anomalies with the motor experiment.

        config APP_RT_DIAGNOSTICS_APPLICATION_REPORT_FULL
            bool "Full motor/current/recorder report"
            help
                Print the complete motor, PID, dual current-sense, and
                recorder report. This produces substantially more serial
                traffic and can perturb the following diagnostic window.

    endchoice

endmenu

menu "Open-loop Calibration Profile"

    config APP_OPEN_LOOP_DUTY_LOW_PERCENT
        int "Open-loop low duty (percent)"
        range 0 100
        default 40
        help
            Unsigned bridge duty used during the first and third calibration
            stages. Select a value that maintains several complete rotations
            without saturating the sensor or supply. This profile bypasses the
            PID and is started only by the CAL START USB command.

    config APP_OPEN_LOOP_DUTY_HIGH_PERCENT
        int "Open-loop high duty (percent)"
        range 0 100
        default 55
        help
            Unsigned bridge duty used during the middle calibration stage.
            A second speed helps verify that the angular LUT describes a
            position-dependent sensor error rather than one operating point.
            This value should normally exceed the low-duty setting.

    config APP_OPEN_LOOP_STAGE_SECONDS
        int "Open-loop stage duration (seconds)"
        range 1 120
        default 8
        help
            Duration of each low/high/low duty stage. Eight seconds per stage
            lets the five-channel 500 Hz calibration capture include complete
            settled revolutions and apply BRAKE before the default 128 KiB
            recorder buffer becomes full. Increasing it can make the buffer
            fill before the terminal stage; decreasing it can leave too few
            complete revolutions for a reliable LUT.

endmenu
```
